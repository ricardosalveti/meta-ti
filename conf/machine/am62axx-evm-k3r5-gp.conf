## conf/machine/am62axx-evm-k3r5-gp.conf
```bitbake
#@TYPE: Machine
#@NAME: AM62A GP EVM (R5F)
#@DESCRIPTION: Machine configuration for the TI AM62A GP EVM (R5F core)

# Booting GP requires different SYSFW, the rest is handled at runtime

require conf/machine/include/k3r5.inc
SOC_FAMILY_append = ":k3r5-gp"

SYSFW_SOC = "am62ax"
SYSFW_CONFIG = "evm"
SYSFW_SUFFIX = "gp"
SYSFW_TIBOOT3_SYMLINK = ""

UBOOT_MACHINE = "am62ax_evm_r5_defconfig"

SPL_BINARY = ""
UBOOT_BINARY = "u-boot-spl.${UBOOT_SUFFIX}"
UBOOT_IMAGE = "u-boot-r5spl-gp-${MAINMACHINE}-${PV}-${PR}.${UBOOT_SUFFIX}"
UBOOT_SYMLINK = "u-boot-r5spl-gp.${UBOOT_SUFFIX}"
```
